## src/cpu/intel/model_106ax/Kconfig
```kconfig
config CPU_INTEL_CORE_I7_920
	bool
	select SMP
	select SSE2
	select UDELAY_LAPIC
	select AP_IN_SIPI_WAIT
```

## src/mainboard/gigabyte/ex58-ud4p/Kconfig
```kconfig
if BOARD_GIGABYTE_EX58_UD4P

config BOARD_SPECIFIC_OPTIONS # dummy
	def_bool y
	select ARCH_X86
	select CPU_INTEL_CORE_I7_920
	select CPU_INTEL_SOCKET_LGA1366
	select NORTHBRIDGE_INTEL_CORE_I7
	select SOUTHBRIDGE_INTEL_I82801JIR
	select SOUTHBRIDGE_INTEL_X58
#	select SUPERIO_WINBOND_W83627THG
	select BOARD_HAS_FADT
#	select GENERATE_ACPI_TABLES
	select GENERATE_PIRQ_TABLE
	select GENERATE_MP_TABLE
	select HAVE_OPTION_TABLE
#	select HAVE_HARD_RESET
#	select HAVE_ACPI_RESUME
	select MMCONF_SUPPORT
#	select HAVE_SMI_HANDLER
	select BOARD_ROMSIZE_KB_1024
	select CACHE_AS_RAM
	select GFXUMA
	select TINY_BOOTBLOCK

config MAINBOARD_DIR
	string
	default gigabyte/ex58-ud4p

config DCACHE_RAM_BASE
	hex
	default 0xffdf8000

config DCACHE_RAM_SIZE
	hex
	default 0x10000

config MAINBOARD_PART_NUMBER
	string
	default "EX58-UD4P"

config MMCONF_BASE_ADDRESS
	hex
	default 0xf0000000

config IRQ_SLOT_COUNT
	int
	default 18

config MAX_CPUS
	int
	default 4

config MAX_PHYSICAL_CPUS
	int
	default 2

config FALLBACK_VGA_BIOS_FILE
	string
	default "amipci_01.20"

endif # BOARD_GIGABYTE_EX58_UD4P
```

## src/northbridge/intel/core_i7/Kconfig
```kconfig
##
## This file is part of the coreboot project.
##
## Copyright (C) 2007-2009 coresystems GmbH
##
## This program is free software; you can redistribute it and/or modify
## it under the terms of the GNU General Public License as published by
## the Free Software Foundation; version 2 of the License.
##
## This program is distributed in the hope that it will be useful,
## but WITHOUT ANY WARRANTY; without even the implied warranty of
## MERCHANTABILITY or FITNESS FOR A PARTICULAR PURPOSE.  See the
## GNU General Public License for more details.
##
## You should have received a copy of the GNU General Public License
## along with this program; if not, write to the Free Software
## Foundation, Inc., 51 Franklin St, Fifth Floor, Boston, MA  02110-1301 USA
##

config NORTHBRIDGE_INTEL_CORE_I7
	bool

if NORTHBRIDGE_INTEL_CORE_I7

config NORTHBRIDGE_SPECIFIC_OPTIONS
	def_bool y
	select HAVE_DEBUG_RAM_SETUP
	select NORTHBRIDGE_INTEL_CORE_I7_ROOT_COMPLEX

config FALLBACK_VGA_BIOS_ID
	string
	default "8086,27a2"

source src/northbridge/intel/core_i7/root_complex/Kconfig

endif # NORTHBRIDGE_INTEL_CORE_I7
```
